## kernel-4.4/drivers/video/fbdev/ingenic/fb_v12/Kconfig
```kconfig
menuconfig FB_INGENIC_V12
	tristate "Ingenic Framebuffer Driver for Version 12"
	depends on FB_INGENIC
	select FB_INGENIC_DISPLAYS_V12
	select FB_CFB_FILLRECT
	select FB_CFB_COPYAREA
	select FB_CFB_IMAGEBLIT
	help
	  Framebuffer support for the Version 12 DPU SoC.


config INGENIC_FB_SIMPLE_RDMA
	tristate "Use SIMPLE RDMA in dpu driver"
	depends on FB_INGENIC_V12
	default n
	help
	    use simple rdma in dpu driver. for advacned usage.
	    this will cause more memory allocated.

config MIPI_TX_LANE
	tristate "MIPI_TX_LANE"
	depends on FB_INGENIC_V12
	choice
		prompt "2 LANE or 4 LANE"
		depends on MIPI_TX_LANE
		config MIPI_2LANE
			bool "2LANE"
		config MIPI_4LANE
			bool "4LANE"
	endchoice



source "drivers/video/fbdev/ingenic/fb_v12/displays/Kconfig"
```
